/*
 * Copyright (C) 2014 STMicroelectronics Limited.
 * Author: Amelie Herault <amelie.herault@st.com>
 *
 * This program is free software; you can redistribute it and/or modify
 * it under the terms of the GNU General Public License version 2 as
 * published by the Free Software Foundation.
 */
#ifdef CONFIG_SYNO_LSP_MONACO_SDK2_15_4
#include "stih410-clock.dtsi"
#include "stih407-family.dtsi"
#else /* CONFIG_SYNO_LSP_MONACO_SDK2_15_4 */
#include "stih301cut1.dtsi"
#endif /* CONFIG_SYNO_LSP_MONACO_SDK2_15_4 */

/ {
#ifdef CONFIG_SYNO_LSP_MONACO_SDK2_15_4
	soc {
		st_usb_bus_config: st-usb-amba-config {
			st,complete_on_error;
			st,read_ahead;
			st,max_opcode_LD64_ST64;
			st,chunks_in_msg = <0>;
			st,packets_in_chunk = <2>;
			st,threshold = <256>;
#else /* CONFIG_SYNO_LSP_MONACO_SDK2_15_4 */
	cpus {
		cpu@0 {
			operating-points = <
				/* kHz    ignored */
				 1000000  1000000
				  500000  1000000
				  250000  1000000
			>;
#endif /* CONFIG_SYNO_LSP_MONACO_SDK2_15_4 */
		};
	};
};
